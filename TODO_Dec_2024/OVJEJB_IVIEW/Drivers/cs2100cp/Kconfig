## ToBkup-Dec2024/archive_name/data/home/mirfaisal/CBDL-VQ/samsung/debug/Kconfig
```kconfig
menuconfig EXYNOS_DEBUG
        bool "Exynos Debug Features"
        depends on ARCH_EXYNOS
        default n

if EXYNOS_DEBUG
menuconfig DEBUG_SNAPSHOT
	tristate "Debug SnapShot Support"
	depends on EXYNOS_DEBUG
	default n
	help
	  Debug snapshot supports SoC debugging easily. This feature supports
	  to trace kernel events and other module events such frequceny change
	  and IPC. This supports to save GPR and PC when panic or exception and
	  to enter ramdump mode when panic is occurred and other exception.
	  This supports to reserve memory for h/w debug feature such as
	  scan2dram, arraydump.

config DEBUG_SNAPSHOT_USE_ANDROID_VH_LOGBUF
        bool "Use andorid_vh_logbuf to store kernel log"
	depends on ANDROID_VENDOR_HOOKS
	depends on DEBUG_SNAPSHOT
	default y
	help
          Use andorid_vh_logbuf to store kernel log. if you don't select
	  this configuration, debug snapshot use dss console driver to store
	  kernel log. but it stores under configured loglevel. but if you select
	  this configuration, dss can store kernel log regardless of loglevel

config DEBUG_SNAPSHOT_FREQ_DOMAIN_NUM
	int "Number of freq logging domain type"
	range 4 32
	default 32
	help
	  This option decides number of frequency logging domain type.

config DEBUG_SNAPSHOT_LOG_NR_CPUS
	int "Number of CPUs to store logs in kevent area"
	range 4 32
	default 10
	help
	  This option decides number of cores to store logs in kevent area.

config DEBUG_SNAPSHOT_LOG_ITEM_SIZE
	int "Number of logging item base size"
	range 256 1024
	default 1024
	help
	  This option decides size of logging item.

config DEBUG_SNAPSHOT_SFRDUMP
	tristate "Debug Snapshot SFRDUMP"
	depends on DEBUG_SNAPSHOT
	default n
	help
	  This supports sfrdump to string format into the DRAM
	  if kernel panic happened. If you want to get dump,
	  you should write list of sfr registers in device tree.
	  If you want to dump sfr register, you say Y here.

config DEBUG_SNAPSHOT_DEBUG_KINFO
	tristate "Debug Kernel Information Support"
	depends on DEBUG_SNAPSHOT
        default n
	help
	  This prepares memory for the debug-kinfo driver

config EXYNOS_DEBUG_TEST
	tristate "Exynos debug feature test"
	depends on DEBUG_SNAPSHOT && DEBUG_FS
	default n

config EXYNOS_EHLD
	tristate "Exynos support Early Hardlockup Detector"
	depends on EXYNOS_DEBUG
	default n

config EXYNOS_HARDLOCKUP_WATCHDOG
	tristate "Exynos Hardlockup Watchdog"
	depends on DEBUG_SNAPSHOT
	default n

config EXYNOS_ADV_TRACER
	tristate "Exynos Advanced Tracer"
	depends on EXYNOS_DEBUG
	default n

config EXYNOS_ADV_TRACER_S2D
	tristate "Exynos Advanced Tracer: Plug-in - S2D"
	depends on EXYNOS_ADV_TRACER
	default n

config EXYNOS_ITMON
	tristate "Exynos IPs Traffic Monitor"
	depends on EXYNOS_DEBUG
	default n
	help
	  This option enables runtime BUS tracing by TREX
	  (Traffic Express) System, which is BUS backbone
	  in Samsung SoC.

config EXYNOS_CORESIGHT
	tristate "Enable Coresight of exynos"
	depends on EXYNOS_DEBUG
	default n

config EXYNOS_ECC_HANDLER
	tristate "Exynos support ECC handler"
	depends on EXYNOS_DEBUG
	default n

config PANIC_FINGERPRINT
	tristate "Enable panic fingerprint"
	default n
endif
```

## ToBkup-Dec2024/archive_name/data/home/mirfaisal/CBDL-VQ/samsung/sfi/Kconfig
```kconfig
#
# SFI driver configuration
#

menuconfig EXYNOS_SFI_IPC
	tristate "SFI IPC driver support"
	help
	  Enable SFI IPC support

menuconfig EXYNOS_SFI_CR52C1
	tristate "CORE1 SFI IPC driver support"
	help
	  Enable CORE1 SFI IPC support

if EXYNOS_SFI_IPC

	config EXYNOS_SFI_IPC_TEST
		tristate "SFI IPC driver test"
		depends on EXYNOS_SFI_IPC
		default n
		help
			Enable SFI IPC Test support

	config EXYNOS_SFI_CLI
		tristate "sfi cli support"
		depends on EXYNOS_SFI_IPC
		default n
		help
			This enables support for SFI console interface

	config EXYNOS_SFI_DUMP
		tristate "sfi dump support"
		depends on EXYNOS_SFI_IPC
		default n
		help
			This enables support for SFI dump feature

    config EXYNOS_SFI_CLKMON
		tristate "sfi clkmon support"
		depends on EXYNOS_SFI_IPC
		default n
		help
			This enables support for SFI CLKMON feature

endif

if EXYNOS_SFI_CR52C1

	config EXYNOS_SFI_IPC_TEST_C1
		tristate "CORE1 SFI IPC driver test"
		depends on EXYNOS_SFI_CR52C1
		default n
		help
			Enable CORE1 SFI IPC Test support

	config EXYNOS_SFI_CLI_C1
		tristate "sfi core1 cli support"
		depends on EXYNOS_SFI_CR52C1
		default n
		help
			This enables support for SFI CORE1 console interface

endif
```
