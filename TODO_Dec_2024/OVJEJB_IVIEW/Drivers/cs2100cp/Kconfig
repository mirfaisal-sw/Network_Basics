## TODO_Dec_2024/OVJEJB_IVIEW/Drivers/cs2100cp/Kconfig
```kconfig
# SPDX-License-Identifier: GPL-2.0-only
#
config CIRRUS_CS2100_PLL
	tristate "support for PLL driver on I2C bus"
	default n
	select REGMAP
	select REGMAP_I2C
	help
	  This Regmap I2C driver configures the Cirrus Logic
	  CS2100 PLL for high accuracy output. The CS2100-CP
	  is an extremely versatile system clocking device
	  that utilizes a programmable phase lock loop.
```

## TODO_Dec_2024/OVJEJB_IVIEW/Drivers/dynamic_spi_node/Kconfig
```kconfig
#
# SPI DYNAMIC NODE
#
config SPI_DYNAMIC_NODE
	tristate "Support for dynamic SPI device node creation"
	depends on SPI && SPI_OMAP24XX && HARMAN_DRIVERS
	help
		Support for dynamic SPI device node creation.
```

## TODO_Dec_2024/OVJEJB_IVIEW/Drivers/earlydata/Kconfig
```kconfig
config HARMAN_EARLYDATA
	bool "Harman earlyboot driver"
	default y
	help
	  This is harman driver for providing early data to userspace
```

## TODO_Dec_2024/OVJEJB_IVIEW/Drivers/fs3ipc_uart/Kconfig
```kconfig
#
# FS3IPC UART IOC IPC driver configuration
#

menuconfig FS3IPC_UART
	tristate "UART based FS3IPC IOC IPC Driver"
	depends on SERIAL_DEV_CTRL_TTYPORT
	default n
	help
	   This enables UART based FS3IPC IOC IPC Driver.

if FS3IPC_UART

config FS3IPC_DEBUG
	bool "For FS3IPC_UART statistics via /dev/ipcdebug"
	help
	  Say Y here if you want to enable FS3IPC_UART driver
	  statistics via /dev/ipcdebug.

config FS3IPC_SIMULATE_TXRX
	bool "Enable simulateTx and simulateRx for FS3IPC"
	depends on FS3IPC_DEBUG
	help
	  Say Y here if you want to enable simulateTx and simulateRx
	  via /dev/ipcdebug that can be used to simulate the IPC
	  message communication with IOC. Keep this disabled in
	  production environment to avoid security concern of
	  enabling/disabling critical functionality like watchdog
	  over FS3IPC.

endif #FS3IPC_UART
```

## TODO_Dec_2024/OVJEJB_IVIEW/Drivers/pnp_plugin/Kconfig
```kconfig
menu "SPI PNP Plugin"

config SPI_PNP_PLUGIN
        tristate "SPI PNP plugin support for OMAP specific SPI controllers"
        depends on SPI && SPI_OMAP24XX && HARMAN_DRIVERS
        help
                Special PNP plugin for omap specific spi controllers

endmenu
```

## ToBkup-Dec2024/archive_name/data/home/mirfaisal/CBDL-VQ/dabplugin/Kconfig
```kconfig
menu "SPI dabplugin"

config DAB_PLUGIN
	tristate
	default n
	depends on m

config SPI_DAB_PLUGIN
        bool "SPI DAB plugin support for OMAP specific SPI controllers"
        depends on SPI && SPI_OMAP24XX && m
	select DAB_PLUGIN
        help
                Special DAB plugin for omap specific spi controllers

config GENERIC_SPI_DAB_PLUGIN
        bool "Generic platform independent DAB plugin support"
        depends on SPI && m
	select DAB_PLUGIN
        help
                Special DAB plugin

endmenu
```

## ToBkup-Dec2024/archive_name/data/home/mirfaisal/CBDL-VQ/harman/Kconfig
```kconfig
menu "Device Harman Drivers"

config HARMAN_DRIVERS
	tristate "HARMAN_DRIVERS"

source "drivers/harman/dabplugin/Kconfig"
source "drivers/harman/dynamic_spi_node/Kconfig"
source "drivers/harman/slave_mcspi/Kconfig"
source "drivers/harman/dspipc/Kconfig"
source "drivers/harman/v4l2-mvif_v1/Kconfig"
source "drivers/harman/v4l2-mvif_v2/Kconfig"
source "drivers/harman/dsp_mmu/Kconfig"
source "drivers/harman/pnp_plugin/Kconfig"
endmenu
```

## ToBkup-Dec2024/archive_name/data/home/mirfaisal/CBDL-VQ/harman/dsp_mmu/Kconfig
```kconfig
# (slave mcspi support would go here)

config TMS320C674x_MMU_FAULT_HANDLER
    tristate "Handle MMU Fault from DSP MMU core"
    depends on ARCH_OMAP2PLUS || CONFIG_IUKRAM
    help
	Trace driver to output fault address of DSP MMU, also
	adds TLB entry on fault to unlock DSP to run its exception handler
```

## ToBkup-Dec2024/archive_name/data/home/mirfaisal/CBDL-VQ/harman/slave_mcspi/Kconfig
```kconfig
# (slave mcspi support would go here)

config SPI_OMAP24XX_SLAVE
    tristate "McSPI in  slave mode driver for OMAP"
    depends on ARM || ARM64 || AVR32 || HEXAGON || MIPS || SH
    depends on ARCH_OMAP2PLUS || COMPILE_TEST
    help
      SPI slave controller for OMAP24XX and later Multichannel SPI
      (McSPI) modules.

config SPI_OMAP24XX_SLAVE_SUPPORT
    bool "Mcspi slave controller support"
    depends on SPI_OMAP24XX_SLAVE
    default y

config SPI_OMAP24XX_SLAVE_ID
    depends on SPI_OMAP24XX_SLAVE
    hex "Slave controller id"
    default "0xffff"
                      
```

## ToBkup-Dec2024/archive_name/data/home/mirfaisal/CBDL-VQ/harman/v4l2-mvif_v1/Kconfig
```kconfig
#
# Vsink MVIF Driver
#
config V4L2_MVIF
    tristate "Vsink MVIF Driver"
    depends on VIDEO_DEV && VIDEO_V4L2
	select VIDEOBUF2_CORE
	select VIDEOBUF2_MEMOPS
    default n
    help
      Enables this driver to support MVIF based video streaming on J6
	  borad using the v4l2 framework
      Say Y here if you want to use MVIF to stream video to other cores
      In doubt, say N.

config V4L2_V1
    tristate "V4L2 ORIGINAL"
     default n
     help
       Enable this feature if you want use old implimentation
       or say N so that new implimentation will be used.
```

## ToBkup-Dec2024/archive_name/data/home/mirfaisal/CBDL-VQ/harman/v4l2-mvif_v2/Kconfig
```kconfig
#
# Vsink MVIF Driver
#
config V4L2_MVIF
    tristate "Vsink MVIF Driver"
    depends on VIDEO_DEV && VIDEO_V4L2
	select VIDEOBUF2_CORE
	select VIDEOBUF2_MEMOPS
    default n
    help
      Enables this driver to support MVIF based video streaming on J6
	  borad using the v4l2 framework
      Say Y here if you want to use MVIF to stream video to other cores
      In doubt, say N.

config V4L2_V2
    tristate "V4L2 ENHANCED"
     default n
     help
       Enable this feature if you want use old implimentation
       or say N so that old implimentation will be used

config V4L2_DUAL_DMB
    tristate "DUAL DMB SUPPORT"
     default n
       help
       Say Y if you want to use dual DMB feature or say N
```

## ToBkup-Dec2024/archive_name/data/home/mirfaisal/CBDL-VQ/samsung/Kconfig
```kconfig
# SPDX-License-Identifier: GPL-2.0
#
# Samsung SoC drivers
#
menuconfig SOC_SAMSUNG
	bool "Samsung SoC driver support" if COMPILE_TEST

config SOC_EXYNOSAUTO9
	bool "Samsung EXYNOSAUTO9"
	select SOC_SAMSUNG
	help
	  Support Samsung SOC ExynosAuto9 SoC.

if SOC_SAMSUNG

# There is no need to enable these drivers for ARMv8
config EXYNOS_ASV_ARM
	bool "Exynos ASV ARMv7-specific driver extensions" if COMPILE_TEST
	depends on EXYNOS_CHIPID

config EXYNOS_CHIPID
	bool "Exynos ChipID controller and ASV driver" if COMPILE_TEST
	depends on ARCH_EXYNOS || COMPILE_TEST
	select EXYNOS_ASV_ARM if ARM && ARCH_EXYNOS
	select MFD_SYSCON
	select SOC_BUS
	help
	  Support for Samsung Exynos SoC ChipID and Adaptive Supply Voltage.

config EXYNOS_CHIPID_V2
	tristate "Exynos Chipid controller driver version2"
	depends on ARCH_EXYNOS
	select MFD_SYSCON
	select SOC_BUS

config EXYNOS_PMU
	bool "Exynos PMU controller driver" if COMPILE_TEST
	depends on ARCH_EXYNOS || ((ARM || ARM64) && COMPILE_TEST)
	select EXYNOS_PMU_ARM_DRIVERS if ARM && ARCH_EXYNOS
	select MFD_CORE

config EXYNOS_PMU_IF
	tristate "Exynos PMU controller Interface driver"
	help
	  Support PMU register API for Exynos SoC.

# There is no need to enable these drivers for ARMv8
config EXYNOS_PMU_ARM_DRIVERS
	bool "Exynos PMU ARMv7-specific driver extensions" if COMPILE_TEST
	depends on EXYNOS_PMU

config EXYNOS_PM_DOMAINS
	bool "Exynos PM domains" if COMPILE_TEST
	depends on (ARCH_EXYNOS && PM_GENERIC_DOMAINS) || COMPILE_TEST

config EXYNOS_BCM_DBG
	bool "EXYNOS_BCM_DBG driver support"
	default y
	help
	  Enable exynos-bcm_dbg driver support

config EXYNOS_BCM_DBG_DUMP
	bool "EXYNOS_BCM_DBG dump support"
	default y
	depends on EXYNOS_BCM_DBG
	help
	  Enable exynos-bcm_dbg dump support

config SAMSUNG_PM_DEBUG
	bool "Samsung PM Suspend debug"
	depends on PM && DEBUG_KERNEL
	depends on PLAT_S3C24XX || ARCH_S3C64XX || ARCH_S5PV210
	depends on DEBUG_S3C24XX_UART || DEBUG_S3C2410_UART
	depends on DEBUG_LL && MMU
	help
	  Say Y here if you want verbose debugging from the PM Suspend and
	  Resume code. See <file:Documentation/arm/samsung-s3c24xx/suspend.rst>
	  for more information.

config S3C_PM_DEBUG_LED_SMDK
       bool "SMDK LED suspend/resume debugging"
       depends on PM && (MACH_SMDK6410)
       help
         Say Y here to enable the use of the SMDK LEDs on the baseboard
	 for debugging of the state of the suspend and resume process.

	 Note, this currently only works for S3C64XX based SMDK boards.

config SAMSUNG_PM_CHECK
	bool "S3C2410 PM Suspend Memory CRC"
	depends on PM && (PLAT_S3C24XX || ARCH_S3C64XX || ARCH_S5PV210)
	select CRC32
	help
	  Enable the PM code's memory area checksum over sleep. This option
	  will generate CRCs of all blocks of memory, and store them before
	  going to sleep. The blocks are then checked on resume for any
	  errors.

	  Note, this can take several seconds depending on memory size
	  and CPU speed.

	  See <file:Documentation/arm/samsung-s3c24xx/suspend.rst>

config SAMSUNG_PM_CHECK_CHUNKSIZE
	int "S3C2410 PM Suspend CRC Chunksize (KiB)"
	depends on PM && SAMSUNG_PM_CHECK
	default 64
	help
	  Set the chunksize in Kilobytes of the CRC for checking memory
	  corruption over suspend and resume. A smaller value will mean that
	  the CRC data block will take more memory, but will identify any
	  faults with better precision.

	  See <file:Documentation/arm/samsung-s3c24xx/suspend.rst>

config EXYNOS_REGULATOR_COUPLER
	bool "Exynos SoC Regulator Coupler" if COMPILE_TEST
	depends on ARCH_EXYNOS || COMPILE_TEST

config EXYNOS_PD_EL3
	tristate "Exynos PD Save/Restore"
	default y
	help
	  Support Exynos Power Domain Save/Restore

config EXYNOS_DRAM_BOOTLOG
        tristate "ExynosAuto9 DRAM Boot Log"
        default n
        help
          Support ExynosAuto9 DRAM Boot Log

config EXYNOS_BOOTTIME_LOG
	tristate "ExynosAuto Boottime Log"
	depends on DEBUG_FS
	help
	  Support ExynosAuto Boottime Log print

config EXYNOS_KERNEL_BOOTTIME
	bool "ExynosAuto Kernel Boottime Measurement"
	depends on EXYNOS_BOOTTIME_LOG
	help
	  Support ExynosAuto Boottime Log measurement & record

choice
	prompt "Boot KPI estimating solution"
	default EXYNOS_KERNEL_BOOTTIME_SMC
	depends on EXYNOS_KERNEL_BOOTTIME

config EXYNOS_BOOTTIME_ESTIMATED_BY_SMC
	bool "Boottime is estimated by smc call"
	help
	  Boottime will be estimated by smc call that EL3 mon should support.
	  This can estimate previous works before initializing kernel memory.
	  EL3 mon does not need initializing kernel memory.

config EXYNOS_BOOTTIME_ESTIMATED_BY_KERNEL_SYSTEM
	bool "Boottime is estimated by kernel system"
	help
	  Boottime will be estimated by kernel system.
	  This cannot estimate previous works before initializing kernel memory.
	  Because logging boottime is executed in kernel memory,
	  initializing kernel memory should be done for this feature

endchoice

config ECT
	tristate "Enable Exynos Characteristic Table File"
	default n
	depends on ARCH_EXYNOS

config ECT_DUMP
	tristate "Enable Exynos Characteristic Table File Dump sysfs"
	default n
	depends on ECT

config EXYNOS_PD
	tristate "Exynos PM domain Support"
	depends on CAL_IF && CMUCAL
	depends on PM
	select PM_GENERIC_DOMAINS

config EXYNOS_PD_DBG
	tristate "Exynos PM domain Debug Support"
	depends on CAL_IF && CMUCAL
	depends on PM
	select PM_GENERIC_DOMAINS

config EXYNOS_PM
	tristate "Enable Exynos PM"
	help
	  Support system power mode for Exynos SoC.

config EXYNOS_PM_TIME
	tristate "Enable Exynos PM TIME"
	depends on SUSPEND
	help
	  Support measuring suspend and resume time for Exynos SoC.

config EXYNOS_FLEXPMU_DBG
	tristate "Exynos FLEXPMU debugging interface"
	depends on PMUCAL
	help
	 Support FLEXPMU for Exynos SoC.

config EXYNOS_PM_QOS
	tristate "Exynos PM QOS"
	default n
	help
	  Support Exynos PM QOS

config EXYNOS_FIRMWARE_SECUREBOOT
	tristate "Exynos Firmware Secure Boot"
	default n
	help
	  Support Exynos Firmware Secureboot


config EXYNOS_SSP
    tristate "Exynos SSP"
    default n
    help
      Support Exynos SSP

config EXYNOS_CONTENT_PATH_PROTECTION
	tristate "Exynos Content Path Protection"
	default m
	help
	  Enable content path protection of EXYNOS.

config EXYNOS_SECURE_LOG
	tristate "Exynos Secure Log"
	default n
	help
	  Support Exynos Secure Log

config EXYNOS_PPMPU_FAIL_DETECTOR
	tristate "Exynos PPMPU Fail Detector"
	default n
	help
	  Support Exynos PPMPU Fail Detector

config EXYNOS_PPMPU_ILLEGAL_READ_LOGGING
	bool "Logging PPMPU Read Fail Information"
	depends on EXYNOS_PPMPU_FAIL_DETECTOR
	default n
	help
	  PPMPU fail information of illegal reads will be printed

config EXYNOS_PPMPU_ILLEGAL_ACCESS_PANIC
	bool "Kernel Panic over PPMPU Illegal Access"
	depends on EXYNOS_PPMPU_FAIL_DETECTOR
	default n
	help
	  Kernel panic will occur in case that PPMPU illegal
	  access is detected.

config EXYNOS_BCM_DBG_DUMP_FILE
	bool "EXYNOS_BCM_DBG dump file support"
	depends on EXYNOS_BCM_DBG_DUMP
	default n
	help
	Enable exynos-bcm_dbg dump file support

source "drivers/soc/samsung/acpm/Kconfig"
source "drivers/soc/samsung/cal-if/Kconfig"
source "drivers/soc/samsung/debug/Kconfig"
source "drivers/soc/samsung/sfi/Kconfig"
source "drivers/soc/samsung/bts/Kconfig"
source "drivers/soc/samsung/exynos-hdcp/Kconfig"
endif
```

## ToBkup-Dec2024/archive_name/data/home/mirfaisal/CBDL-VQ/samsung/acpm/Kconfig
```kconfig
#
# ACPM driver configuration
#

menuconfig EXYNOS_ACPM
	tristate "ACPM driver support"
	depends on ARCH_EXYNOS
	default n
	help
	  Enable ACPM support

config EXYNOS_ACPM_MFD
	bool "EXYNOS_ACPM_MFD support"
	depends on EXYNOS_ACPM
	default n
	help
	  Enable ACPM_MFD support
```

## ToBkup-Dec2024/archive_name/data/home/mirfaisal/CBDL-VQ/samsung/cal-if/Kconfig
```kconfig
#
# CAL_IF driver configuration
#

menuconfig CAL_IF
	tristate "Exynos Chip Abstraction Layer Interface"
	depends on SOC_SAMSUNG
	default n
	help
	Support CMU CAL for Exynos SoC.

config PWRCAL_EXYNOSAUTOV920
	bool "Samsung EXYNOSAUTOV920"
	depends on CAL_IF
	default n
	help
	  Support Samsung PWRCAL ExynosAutov920 SoC.

config PMUCAL
	bool "Exynos PMU Chip Abstraction Layer"
	depends on CAL_IF
	default y
	help
	Support PMUCAL for Exynos SoC.

config PMUCAL_DBG
	tristate "Exynos PMUCAL debugging interface"
	depends on PMUCAL
	help
	Support PMUCAL debugging for Exynos SoC.

config FLEXPMU
	tristate "Exynos FLEXPMU"
	depends on PMUCAL
	help
	Support PMUCAL for Exynos SoC.

config EXYNOS_FLEXPMU_DBG
	tristate "Exynos FLEXPMU DBG"
	depends on FLEXPMU
	help
	Support FLEXPMU for Exynos SoC.

config CMUCAL
	tristate "Exynos CMU Chip Abstraction Layer"
	depends on CAL_IF
	default y
	help
	Support CMUCAL for Exynos SoC.

config CMUCAL_DEBUG
	tristate "CMUCAL Debug Interface"
	depends on CMUCAL
	help
	Support CMUCAL_DEBUG for Exynos SoC.

config ACPM_DVFS
	tristate "Exynos ACPM DVFS manager"
	depends on CAL_IF && CMUCAL
	default n
	help
	Support ACPM DVFS for Exynos SoC.

config CMUCAL_QCH_IGNORE_SUPPORT
	bool "CMUCAL QCH IGNORE Support"
	depends on CMUCAL && !PWRCAL_EXYNOSAUTOV920
	default y
```
